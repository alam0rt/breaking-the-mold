SECTIONS
{
    __romPos = 0;
    _gp = 0x800A5954;
    header_ROM_START = __romPos;
    header_VRAM = ADDR(.header);
    .header : AT(header_ROM_START) SUBALIGN(2)
    {
        FILL(0x00000000);
        header_DATA_START = .;
        build/asm/header.o(.data);
        header_DATA_END = .;
        header_DATA_SIZE = ABSOLUTE(header_DATA_END - header_DATA_START);
    }
    __romPos += SIZEOF(.header);
    header_ROM_END = __romPos;
    header_VRAM_END = .;

    main_ROM_START = __romPos;
    main_VRAM = ADDR(.main);
    .main 0x80010000 : AT(main_ROM_START) SUBALIGN(2)
    {
        FILL(0x00000000);
        main_TEXT_START = .;
        build/asm/crt0.o(.text);
        build/src/crt0stub.o(.text);
        main_RODATA_START = .;
        build/asm/data/gfx.rodata.o(.rodata);
        build/asm/data/hud.rodata.o(.rodata);
        build/asm/data/clayball.rodata.o(.rodata);
        build/asm/data/playst.rodata.o(.rodata);
        build/src/playst.o(.rodata);
        build/asm/data/playst_b.rodata.o(.rodata);
        build/asm/data/vehicle.rodata.o(.rodata);
        build/asm/data/lvlload.rodata.o(.rodata);
        build/asm/data/libc.rodata.o(.rodata);
        build/asm/data/libs/libcd.rodata.o(.rodata);
        build/asm/data/libs/libgpu.rodata.o(.rodata);
        build/asm/data/libs/libspu.rodata.o(.rodata);
        build/src/prim.o(.rodata);
        build/src/vram.o(.rodata);
        build/src/vibrate.o(.rodata);
        build/src/sprite.o(.rodata);
        build/src/spracc.o(.rodata);
        build/src/nullfn.o(.rodata);
        build/src/layer.o(.rodata);
        build/src/entity.o(.rodata);
        build/src/sprset.o(.rodata);
        build/src/anim.o(.rodata);
        build/src/blb.o(.rodata);
        build/src/edtor.o(.rodata);
        build/src/decor.o(.rodata);
        build/src/pickups.o(.rodata);
        build/src/effects.o(.rodata);
        build/src/gamecd.o(.rodata);
        build/src/movie.o(.rodata);
        build/src/enemies.o(.rodata);
        build/src/bosses.o(.rodata);
        build/src/player.o(.rodata);
        build/src/finn.o(.rodata);
        build/src/playdtor.o(.rodata);
        build/src/menu.o(.rodata);
        build/src/passwd.o(.rodata);
        build/src/results.o(.rodata);
        build/src/ending.o(.rodata);
        build/src/level.o(.rodata);
        build/src/blbacc.o(.rodata);
        build/src/sound.o(.rodata);
        build/src/gstate.o(.rodata);
        build/src/entinit.o(.rodata);
        build/src/main.o(.rodata);
        build/src/gstctor.o(.rodata);
        build/src/emptycb.o(.rodata);
        build/src/blbmem.o(.rodata);
        build/src/memmove.o(.rodata);
        build/src/libs/libvoice.o(.rodata);
        build/asm/libs/libspu2.o(.rodata);
        main_SDATA_START = .;
        build/asm/crt0.o(.sdata);
        build/src/crt0stub.o(.sdata);
        build/src/gfx.o(.sdata);
        build/src/hud.o(.sdata);
        build/src/clayball.o(.sdata);
        build/src/gfx.o(.text);
        build/src/prim.o(.text);
        build/src/vram.o(.text);
        build/src/vibrate.o(.text);
        build/src/sprite.o(.text);
        build/src/spracc.o(.text);
        build/src/nullfn.o(.text);
        build/src/layer.o(.text);
        build/src/entity.o(.text);
        build/src/sprset.o(.text);
        build/src/anim.o(.text);
        build/src/blb.o(.text);
        build/src/hud.o(.text);
        build/src/edtor.o(.text);
        build/src/decor.o(.text);
        build/src/pickups.o(.text);
        build/src/effects.o(.text);
        build/src/gamecd.o(.text);
        build/src/movie.o(.text);
        build/src/enemies.o(.text);
        build/src/bosses.o(.text);
        build/src/clayball.o(.text);
        build/src/player.o(.text);
        build/src/playst.o(.text);
        build/src/finn.o(.text);
        build/src/playdtor.o(.text);
        build/src/vehicle.o(.text);
        build/src/menu.o(.text);
        build/src/passwd.o(.text);
        build/src/results.o(.text);
        build/src/ending.o(.text);
        build/src/level.o(.text);
        build/src/blbacc.o(.text);
        build/src/sound.o(.text);
        build/src/gstate.o(.text);
        build/src/lvlload.o(.text);
        build/src/entinit.o(.text);
        build/src/main.o(.text);
        build/src/gstctor.o(.text);
        build/src/emptycb.o(.text);
        build/src/blbmem.o(.text);
        build/src/libc.o(.text);
        build/src/memmove.o(.text);
        build/src/libs/libcd.o(.text);
        build/asm/libs/libgpu.o(.text);
        build/asm/libs/libspu.o(.text);
        build/src/libs/libvoice.o(.text);
        build/asm/libs/libspu2.o(.text);
        main_TEXT_END = .;
        main_TEXT_SIZE = ABSOLUTE(main_TEXT_END - main_TEXT_START);
        main_DATA_START = .;
        build/asm/crt0.o(.data);
        build/src/crt0stub.o(.data);
        build/src/gfx.o(.data);
        build/src/hud.o(.data);
        build/src/clayball.o(.data);
        build/src/playst.o(.data);
        build/asm/data/80FEC.data.o(.data);
        build/src/vram.o(.data);
        build/src/vibrate.o(.data);
        build/src/sprite.o(.data);
        build/src/spracc.o(.data);
        build/src/nullfn.o(.data);
        build/src/layer.o(.data);
        build/src/entity.o(.data);
        build/src/sprset.o(.data);
        build/src/anim.o(.data);
        build/asm/data/8B658.data.o(.data);
        build/src/blb.o(.data);
        build/src/edtor.o(.data);
        build/asm/data/8B944.data.o(.data);
        build/src/decor.o(.data);
        build/src/pickups.o(.data);
        build/src/effects.o(.data);
        build/asm/data/8BBD8.data.o(.data);
        build/src/gamecd.o(.data);
        build/src/movie.o(.data);
        build/src/enemies.o(.data);
        build/asm/data/8BCCC.data.o(.data);
        build/src/bosses.o(.data);
        build/src/player.o(.data);
        build/asm/data/8C974.data.o(.data);
        build/src/finn.o(.data);
        build/src/playdtor.o(.data);
        build/src/menu.o(.data);
        build/src/vehicle.o(.data);
        build/src/lvlload.o(.data);
        build/src/libc.o(.data);
        build/src/libs/libcd.o(.data);
        build/asm/libs/libgpu.o(.data);
        build/asm/libs/libspu.o(.data);
        build/src/prim.o(.data);
        build/src/passwd.o(.data);
        build/src/results.o(.data);
        build/src/ending.o(.data);
        build/src/level.o(.data);
        build/src/blbacc.o(.data);
        build/asm/data/8D37C.data.o(.data);
        build/src/sound.o(.data);
        build/src/gstate.o(.data);
        build/asm/data/8DA28.data.o(.data);
        build/src/entinit.o(.data);
        build/src/main.o(.data);
        build/src/gstctor.o(.data);
        build/src/emptycb.o(.data);
        build/src/blbmem.o(.data);
        build/src/memmove.o(.data);
        build/src/libs/libvoice.o(.data);
        build/asm/libs/libspu2.o(.data);
        build/asm/data/8E2E0.data.o(.data);
        main_DATA_END = .;
        main_DATA_SIZE = ABSOLUTE(main_DATA_END - main_DATA_START);
        build/asm/crt0.o(.rodata);
        build/src/crt0stub.o(.rodata);
        main_RODATA_END = .;
        main_RODATA_SIZE = ABSOLUTE(main_RODATA_END - main_RODATA_START);
        build/asm/data/96154.sdata.o(.sdata);
        build/src/blb.o(.sdata);
        build/src/edtor.o(.sdata);
        build/src/decor.o(.sdata);
        build/src/pickups.o(.sdata);
        build/src/effects.o(.sdata);
        build/asm/data/gamecd.sdata.o(.sdata);
        build/asm/data/movie.sdata.o(.sdata);
        build/src/enemies.o(.sdata);
        build/src/bosses.o(.sdata);
        build/asm/data/96510.sdata.o(.sdata);
        build/src/player.o(.sdata);
        build/src/playst.o(.sdata);
        build/src/finn.o(.sdata);
        build/src/playdtor.o(.sdata);
        build/src/menu.o(.sdata);
        build/src/passwd.o(.sdata);
        build/src/results.o(.sdata);
        build/src/ending.o(.sdata);
        build/src/level.o(.sdata);
        build/src/blbacc.o(.sdata);
        build/src/sound.o(.sdata);
        build/src/gstate.o(.sdata);
        build/src/entinit.o(.sdata);
        build/src/main.o(.sdata);
        build/src/gstctor.o(.sdata);
        build/src/emptycb.o(.sdata);
        build/src/blbmem.o(.sdata);
        build/src/memmove.o(.sdata);
        build/src/libs/libvoice.o(.sdata);
        build/asm/libs/libspu2.o(.sdata);
        build/src/vehicle.o(.sdata);
        build/src/lvlload.o(.sdata);
        build/src/libc.o(.sdata);
        build/src/libs/libcd.o(.sdata);
        build/asm/libs/libgpu.o(.sdata);
        build/asm/libs/libspu.o(.sdata);
        build/src/prim.o(.sdata);
        build/src/vram.o(.sdata);
        build/src/vibrate.o(.sdata);
        build/src/sprite.o(.sdata);
        build/src/spracc.o(.sdata);
        build/src/nullfn.o(.sdata);
        build/src/layer.o(.sdata);
        build/src/entity.o(.sdata);
        build/src/sprset.o(.sdata);
        build/src/anim.o(.sdata);
        build/asm/data/9683C.sdata.o(.sdata);
        main_SDATA_END = .;
        main_SDATA_SIZE = ABSOLUTE(main_SDATA_END - main_SDATA_START);
        main_SBSS_START = .;
        build/asm/crt0.o(.sbss);
        build/src/crt0stub.o(.sbss);
        build/src/gfx.o(.sbss);
        build/src/hud.o(.sbss);
        build/src/clayball.o(.sbss);
        build/src/playst.o(.sbss);
        build/src/vehicle.o(.sbss);
        build/src/lvlload.o(.sbss);
        build/src/libc.o(.sbss);
        build/src/libs/libcd.o(.sbss);
        build/asm/libs/libgpu.o(.sbss);
        build/asm/libs/libspu.o(.sbss);
        build/src/prim.o(.sbss);
        build/src/vram.o(.sbss);
        build/src/vibrate.o(.sbss);
        build/src/sprite.o(.sbss);
        build/src/spracc.o(.sbss);
        build/src/nullfn.o(.sbss);
        build/src/layer.o(.sbss);
        build/src/entity.o(.sbss);
        build/src/sprset.o(.sbss);
        build/src/anim.o(.sbss);
        build/src/blb.o(.sbss);
        build/src/edtor.o(.sbss);
        build/src/decor.o(.sbss);
        build/src/pickups.o(.sbss);
        build/src/effects.o(.sbss);
        build/src/gamecd.o(.sbss);
        build/src/movie.o(.sbss);
        build/src/enemies.o(.sbss);
        build/src/bosses.o(.sbss);
        build/src/player.o(.sbss);
        build/src/finn.o(.sbss);
        build/src/playdtor.o(.sbss);
        build/src/menu.o(.sbss);
        build/src/passwd.o(.sbss);
        build/src/results.o(.sbss);
        build/src/ending.o(.sbss);
        build/src/level.o(.sbss);
        build/src/blbacc.o(.sbss);
        build/src/sound.o(.sbss);
        build/src/gstate.o(.sbss);
        build/src/entinit.o(.sbss);
        build/src/main.o(.sbss);
        build/src/gstctor.o(.sbss);
        build/src/emptycb.o(.sbss);
        build/src/blbmem.o(.sbss);
        build/src/memmove.o(.sbss);
        build/src/libs/libvoice.o(.sbss);
        build/asm/libs/libspu2.o(.sbss);
        build/asm/data/96920.sbss.o(.sbss);
        main_SBSS_END = .;
        main_SBSS_SIZE = ABSOLUTE(main_SBSS_END - main_SBSS_START);
        main_BSS_START = .;
        build/asm/crt0.o(.bss);
        build/src/crt0stub.o(.bss);
        build/src/gfx.o(.bss);
        build/src/hud.o(.bss);
        build/src/clayball.o(.bss);
        build/src/playst.o(.bss);
        build/src/vehicle.o(.bss);
        build/src/lvlload.o(.bss);
        build/src/libc.o(.bss);
        build/src/libs/libcd.o(.bss);
        build/asm/libs/libgpu.o(.bss);
        build/asm/libs/libspu.o(.bss);
        build/src/prim.o(.bss);
        build/src/vram.o(.bss);
        build/src/vibrate.o(.bss);
        build/src/sprite.o(.bss);
        build/src/spracc.o(.bss);
        build/src/nullfn.o(.bss);
        build/src/layer.o(.bss);
        build/src/entity.o(.bss);
        build/src/sprset.o(.bss);
        build/src/anim.o(.bss);
        build/src/blb.o(.bss);
        build/src/edtor.o(.bss);
        build/src/decor.o(.bss);
        build/src/pickups.o(.bss);
        build/src/effects.o(.bss);
        build/src/gamecd.o(.bss);
        build/src/movie.o(.bss);
        build/src/enemies.o(.bss);
        build/src/bosses.o(.bss);
        build/src/player.o(.bss);
        build/src/finn.o(.bss);
        build/src/playdtor.o(.bss);
        build/src/menu.o(.bss);
        build/src/passwd.o(.bss);
        build/src/results.o(.bss);
        build/src/ending.o(.bss);
        build/src/level.o(.bss);
        build/src/blbacc.o(.bss);
        build/src/sound.o(.bss);
        build/src/gstate.o(.bss);
        build/src/entinit.o(.bss);
        build/src/main.o(.bss);
        build/src/gstctor.o(.bss);
        build/src/emptycb.o(.bss);
        build/src/blbmem.o(.bss);
        build/src/memmove.o(.bss);
        build/src/libs/libvoice.o(.bss);
        build/asm/libs/libspu2.o(.bss);
        build/asm/data/96920.bss.o(.bss);
        main_BSS_END = .;
        main_BSS_SIZE = ABSOLUTE(main_BSS_END - main_BSS_START);
    }
    __romPos += SIZEOF(.main);
    __romPos = ALIGN(__romPos, 16);
    main_ROM_END = __romPos;
    main_VRAM_END = .;

    /DISCARD/ :
    {
        *(*);
    }
}
